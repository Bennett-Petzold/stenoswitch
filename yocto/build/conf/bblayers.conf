## yocto/build/conf/bblayers.conf
```bitbake
# POKY_BBLAYERS_CONF_VERSION is increased each time build/conf/bblayers.conf
# changes incompatibly
POKY_BBLAYERS_CONF_VERSION = "2"

BBPATH = "${TOPDIR}"
BBFILES ?= ""

BBLAYERS ?= " \
  ${TOPDIR}/../poky/meta \
  ${TOPDIR}/../poky/meta-poky \
  ${TOPDIR}/../poky/meta-yocto-bsp \
  ${TOPDIR}/../meta-openembedded/meta-oe \
  ${TOPDIR}/../meta-openembedded/meta-multimedia \
  ${TOPDIR}/../meta-openembedded/meta-networking \
  ${TOPDIR}/../meta-openembedded/meta-python \
  ${TOPDIR}/../meta-qt6 \
  ${TOPDIR}/../meta-flutter \
  ${TOPDIR}/../meta-clang \
  ${TOPDIR}/../meta-agl/meta-agl-core/ \
  ${TOPDIR}/../meta-agl/meta-agl-flutter/ \
  ${TOPDIR}/../meta-agl/meta-app-framework/ \
  ${TOPDIR}/../meta-agl-demo \
  ${TOPDIR}/../meta-agl/meta-agl-kuksa-val \
  ${TOPDIR}/../meta-ventoy \
  ${TOPDIR}/../meta-stenoswitch-filesystem \
  ${TOPDIR}/../meta-pypy \
  ${TOPDIR}/../meta-rust-bin \
  ${TOPDIR}/../meta-stenoswitch-rust \
  ${TOPDIR}/../meta-plover \
  ${TOPDIR}/../meta-raspberrypi \
  "
```
