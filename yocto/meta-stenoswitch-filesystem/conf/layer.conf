## yocto/meta-stenoswitch-filesystem/conf/layer.conf
```bitbake
# We have a conf and classes directory, add to BBPATH
BBPATH .= ":${LAYERDIR}"

# We have recipes-* directories, add to BBFILES
BBFILES += "${LAYERDIR}/recipes-*/*/*.bb \
            ${LAYERDIR}/recipes-*/*/*.bbappend"

BBFILE_COLLECTIONS += "stenoswitch_filesystem"
BBFILE_PATTERN_stenoswitch_filesystem = "^${LAYERDIR}/"
LAYERDEPENDS = "core"
LAYERRECOMMENDS = "meta-oe"
LAYERVERSION_stenoswitch_filesystem = "1"
LAYERSERIES_COMPAT_stenoswitch_filesystem = "scarthgap"
```

## yocto/meta-stenoswitch-rust/conf/layer.conf
```bitbake
# We have a conf and classes directory, add to BBPATH
BBPATH .= ":${LAYERDIR}"

# We have recipes-* directories, add to BBFILES
BBFILES += "${LAYERDIR}/recipes-*/*/*.bb \
            ${LAYERDIR}/recipes-*/*/*.bbappend"

BBFILE_COLLECTIONS += "stenoswitch-rust"
BBFILE_PATTERN_stenoswitch-rust = "^${LAYERDIR}/"
LAYERDEPENDS = "rust"
LAYERVERSION_stenoswitch-rust = "1"
LAYERSERIES_COMPAT_stenoswitch-rust = "scarthgap"
```

## yocto/meta-ventoy/conf/layer.conf
```bitbake
# We have a conf and classes directory, add to BBPATH
BBPATH .= ":${LAYERDIR}"

# We have recipes-* directories, add to BBFILES
BBFILES += "${LAYERDIR}/recipes-*/*/*.bb \
            ${LAYERDIR}/recipes-*/*/*.bbappend"

#BBFILE_COLLECTIONS += "ventoy"
#BBFILE_PATTERN_ventoy = "^${LAYERDIR}/"
#BBFILE_PRIORITY_ventoy= "1"
LAYERVERSION_ventoy = "1"
LAYERSERIES_COMPAT_ventoy = "scarthgap"
```

## yocto/stenoswitch.wks
```
# short-description: Create SD card image with a boot partition
# long-description: Creates a partitioned SD card image. Boot files
# are located in the first vfat partition.

part --source bootimg-partition --ondisk mmcblk0 --fstype=vfat --label boot --active --align 4 --fixed-size 400M
# Deliberately oversized for future updates
part / --source rootfs --ondisk mmcblk0 --fstype=squashfs --fsoptions ro --align 4 --mkfs-extraopts="-comp zstd" --fixed-size 1G
```
